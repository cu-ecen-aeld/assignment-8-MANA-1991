## base_external/package/aesd-assignments/Config.in
```kconfig
config BR2_PACKAGE_AESD_ASSIGNMENTS
	bool "aesd-assignments"
	help
	  Includes the aesdsocket application as developed for assignment 5, part 1.
```

## base_external/package/aesdchar/Config.in
```kconfig
config BR2_PACKAGE_AESDCHAR
	bool "aesdchar"
	help
	  Linux driver development assignment (on Buildroot, obviously)
```
